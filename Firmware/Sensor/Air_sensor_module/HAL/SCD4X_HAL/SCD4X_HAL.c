/*
 * SCD4X_HAL.c
 *
 *  Created on: Mar 23, 2024
 *      Author: thang
 */

#include "SCD4X_HAL.h"


typedef struct measurements {
    scd4x_sensor_value_t co2;
    scd4x_sensor_value_t temperature;
    scd4x_sensor_value_t humidity;
} measurements_t;

#define CMD_START_PERIODIC_MEASUREMENT             (0x21B1)
#define CMD_READ_MEASUREMENT                       (0xEC05)
#define CMD_STOP_PERIODIC_MEASUREMENT              (0x3F86)
#define CMD_SET_TEMPERATURE_OFFSET                 (0x241D)
#define CMD_GET_TEMPERATURE_OFFSET                 (0x2318)
#define CMD_SET_SENSOR_ALTITUDE                    (0x2427)
#define CMD_GET_SENSOR_ALTITUDE                    (0x2322)
#define CMD_SET_AMBIENT_PRESSURE                   (0xE000)
#define CMD_PERFORM_FORCED_RECALIBRATION           (0x362F)
#define CMD_SET_AUTOMATIC_SELF_CALIBRATION_ENABLED (0x2416)
#define CMD_GET_AUTOMATIC_SELF_CALIBRATION_ENABLED (0x2313)
#define CMD_START_LOW_POWER_PERIODIC_MEASUREMENT   (0x21AC)
#define CMD_GET_DATA_READY_STATUS                  (0xE4B8)
#define CMD_PERSIST_SETTINGS                       (0x3615)
#define CMD_GET_SERIAL_NUMBER                      (0x3682)
#define CMD_PERFORM_SELF_TEST                      (0x3639)
#define CMD_PERFORM_FACTORY_RESET                  (0x3632)
#define CMD_REINIT                                 (0x3646)
#define CMD_MEASURE_SINGLE_SHOT                    (0x219D)
#define CMD_MEASURE_SINGLE_SHOT_RHT_ONLY           (0x2196)
#define CMD_POWER_DOWN                             (0x36E0)
#define CMD_WAKE_UP                                (0x36F6)

/*
* The 8-bit CRC checksum transmitted after each data word is generated by a CRC algorithm.
* The CRC covers the contents of the two previously transmitted data bytes.
* To calculate the checksum only these two previously transmitted data bytes are used.
* Note that command words are not followed by CRC.
*/
void scd4x_init(){
    switch(I2C_HAL_ping(SCD4X_ADDR)){
        case(I2C_OK):
//            printf("SCD4X founded!!!\r\n");
            break;
        case(I2C_BUSY):
//            printf("ERROR: I2C bus is busy!!!\r\n");
            return;
            break;
        case(I2C_NO_ACK):
//            printf("ERROR: SCD4X not found!!!\r\n");
            break;
        default:
            ;
    }
    return;
}
static uint8_t scd4x_generate_crc(const uint8_t* data, uint16_t count) {
    uint16_t current_byte;
    uint8_t crc = CRC8_INIT;
    uint8_t crc_bit;

    for(current_byte = 0; current_byte < count; ++current_byte) {
        crc ^= (data[current_byte]);
        for(crc_bit = 8; crc_bit > 0; --crc_bit) {

            if (crc & 0x80) {
                crc = (crc << 1) ^ CRC8_POLYNOMIAL;
            } else {
                crc = (crc << 1);
            }
        }
    }
    return crc;
}

static uint16_t swap(uint16_t v){
    uint16_t temp = ((v >> 8) & 0xFF) | ((v << 8) & 0xFF00);

    return temp;
}

void scd4x_send_command(uint16_t command, uint16_t* data, uint8_t size){
    uint8_t buf[2 + size * 3];
    // add command
    *(uint16_t *)buf = swap(command);
    if (data && size){
        // add arguments
        for (size_t i = 0; i < size; i++)
        {
            uint8_t *p = buf + 2 + i * 3;
            *(uint16_t *)p = swap(data[i]);
            *(p + 2) = scd4x_generate_crc(p, 2);
        }
    }
    I2C_HAL_master_write(SCD4X_ADDR, buf, sizeof(buf));
}

void scd4x_read_resp(uint16_t *data, uint8_t size){
    uint8_t buf[size*3];
    I2C_HAL_master_read(SCD4X_ADDR, NULL, 0, buf, sizeof(buf));
    for (size_t i = 0; i < size; i++){
        uint8_t *p = buf + i * 3;
        uint8_t crc = scd4x_generate_crc(p, 2);
        if (crc != *(p + 2)){
            printf("Invalid CRC 0x%02x, expected 0x%02x*\r\n", crc, *(p + 2));
            return;
        }
//        printf("before change: 0x%X%X\r\n", *p, *(p+1));
//        uint16_t temp = 0;
//        if(p != NULL){
//            temp = *(uint16_t *)p;
//        }
        data[i] = *(p+1) | (*p << 8);
//        printf("change 0x%X%x to 0x%X\r\n", *p, *(p+1), data[i]);
//        data[i] = swap(*(uint16_t *)p);
    }
}

void execute_command(uint16_t command, uint32_t delay_time, uint16_t* out_data, uint8_t out_size, uint16_t* in_data, uint8_t in_size){
    scd4x_send_command(command,out_data, out_size);
    if(delay_time){
        if(delay_time > 10){
            Delay_Ms(delay_time);
        }
        else{
            Delay_Us(delay_time*1000);
        }
    }
    if(in_data && in_size){
        scd4x_read_resp(in_data, in_size);
    }
}

void scd4x_start_periodic_measurement(){
    execute_command(CMD_START_PERIODIC_MEASUREMENT, 1, NULL, 0, NULL, 1);
}

void scd4x_read_measurement_ticks(uint16_t* co2, uint16_t* temperature, uint16_t* humidity){
    uint16_t buf[3];
    execute_command(CMD_READ_MEASUREMENT, 1, NULL, 0, buf, 3);
    if(co2){
        *co2 = buf[0];
    }
    if(temperature){
        *temperature = buf[1];
    }
    if(humidity){
        *humidity = buf[2];
    }
}

void scd4x_read_measurement(uint16_t* co2, float* temperature, float* humidity){
    uint16_t t_raw, h_raw;
    scd4x_read_measurement_ticks(co2, &t_raw, &h_raw);
    if(temperature){
        *temperature = (float)t_raw * 175.0f / 65536.0f - 45.0f;
    }
    if(humidity){
        *humidity = (float)h_raw * 100.0f / 65536.0f;
    }
    return;
}

void scd4x_stop_periodic_measurement(){
    return execute_command(CMD_STOP_PERIODIC_MEASUREMENT, 500, NULL, 0, NULL, 0);
}

void scd4x_get_temperature_offset_ticks(uint16_t* t_offset){
    return execute_command(CMD_GET_TEMPERATURE_OFFSET, 1, NULL, 0, t_offset, 1);
}

void scd4x_get_temperature_offset(float* t_offset){
    uint16_t raw;
    scd4x_get_temperature_offset_ticks(&raw);
    *t_offset = (float)raw * 175.0f / 65536.0f;
    return;
}

void scd4x_set_temperature_offset_ticks(uint16_t t_offset){
    return execute_command(CMD_SET_TEMPERATURE_OFFSET, 1, &t_offset, 1, NULL, 0);
}

void scd4x_set_temperature_offset(float t_offset){
    uint16_t raw = (uint16_t)(t_offset * 65536.0f / 175.0f + 0.5f);
    return scd4x_set_temperature_offset_ticks(raw);
}

void scd4x_get_sensor_altitude(uint16_t* altitude){
    return execute_command(CMD_GET_SENSOR_ALTITUDE, 1, NULL, 0, altitude, 1);
}

void scd4x_set_sensor_altitude(uint16_t altitude){
    return execute_command(CMD_SET_SENSOR_ALTITUDE, 1, &altitude, 1, NULL, 0);
}

void scd4x_set_ambient_ressure(uint16_t pressure){
    return execute_command(CMD_SET_AMBIENT_PRESSURE, 1, &pressure, 1, NULL, 0);
}

void scd4x_perform_forced_recalibration(uint16_t target_co2_concentration, uint16_t *frc_correction){
    return  execute_command(CMD_PERFORM_FORCED_RECALIBRATION, 400, &target_co2_concentration, 1, frc_correction, 1);
}

void scd4x_get_automatic_self_calibration(bool* enable){
    return execute_command(CMD_GET_AUTOMATIC_SELF_CALIBRATION_ENABLED, 1, NULL, 0, (uint16_t *)enable, 1);
}

void scd4x_set_automatic_self_calibration(bool enable){
    return execute_command(CMD_SET_AUTOMATIC_SELF_CALIBRATION_ENABLED, 1, (uint16_t *)&enable, 1, NULL, 0);
}

void scd4x_start_low_power_periodic_measurement(){
    return execute_command(CMD_START_LOW_POWER_PERIODIC_MEASUREMENT, 0, NULL, 0, NULL, 0);
}

void scd4x_get_data_ready_status(bool *data_ready){
    uint16_t status;
    execute_command(CMD_GET_DATA_READY_STATUS, 1, NULL, 0, &status, 1);
    *data_ready = (status & 0x7ff) != 0;
}

void scd4x_persist_settings(){
    return execute_command(CMD_PERSIST_SETTINGS, 800, NULL, 0, NULL, 0);
}

void scd4x_get_serial_number(uint16_t *serial0, uint16_t *serial1, uint16_t *serial2){

    uint16_t buf[3];
    execute_command(CMD_GET_SERIAL_NUMBER, 1, NULL, 0, buf, 3);
    *serial0 = buf[0];
    *serial1 = buf[1];
    *serial2 = buf[2];

    return;
}

void scd4x_perform_self_test(bool *malfunction){

    return execute_command(CMD_PERFORM_SELF_TEST, 10000, NULL, 0, (uint16_t *)malfunction, 1);
}

void scd4x_perform_factory_reset(){
    return execute_command(CMD_PERFORM_FACTORY_RESET, 800, NULL, 0, NULL, 0);
}

void scd4x_reinit(){
    return execute_command(CMD_REINIT, 20, NULL, 0, NULL, 0);
}

void scd4x_measure_single_shot(){
    return execute_command(CMD_MEASURE_SINGLE_SHOT, 5000, NULL, 0, NULL, 0);
}

void scd4x_measure_single_shot_rht_only(){
    return execute_command(CMD_MEASURE_SINGLE_SHOT_RHT_ONLY, 50, NULL, 0, NULL, 0);
}

void scd4x_power_down(){
    return execute_command(CMD_POWER_DOWN, 1, NULL, 0, NULL, 0);
}

void scd4x_wake_up(){
    return execute_command(CMD_WAKE_UP, 20, NULL, 0, NULL, 0);
}
